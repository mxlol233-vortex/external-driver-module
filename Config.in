## package/kernel-modules/Config.in
```kconfig
source "$BR2_EXTERNAL_DRIVER_MODULE_PATH/package/kernel-modules/simple_pci/Config.in"
```

## package/kernel-modules/simple_pci/Config.in
```kconfig
config BR2_PACKAGE_KMOD_EXAMPLE
	bool "simple_pci"
	depends on BR2_LINUX_KERNEL
	help
		Simple simple pci device for QEMU.
```
